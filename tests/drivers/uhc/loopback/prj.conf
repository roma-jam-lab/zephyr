## CMakeLists.txt
```
# SPDX-License-Identifier: Apache-2.0
cmake_minimum_required(VERSION 3.20.0)
find_package(Zephyr REQUIRED HINTS $ENV{ZEPHYR_BASE})
project(uhc_usb_loopback_device)

target_sources(app PRIVATE src/main.c src/loopback.c)
```

## sample.yaml
```
sample:
  name: USB UHC loopback test hardware device
  description: Vendor control payload store/readback fixture for UHC driver testing

tests:
  sample.usb.uhc_loopback_device:
    build_only: true
    tags:
      - usb
      - uhc
    filter: dt_nodelabel_enabled("zephyr_udc0")
```

## prj.conf
```kconfig
# SPDX-FileCopyrightText: 2026 Roman Leonov <jam_roma@yahoo.com>
#
# SPDX-License-Identifier: Apache-2.0

CONFIG_USB_DEVICE_STACK_NEXT=y
CONFIG_USBD_VREQ_SUPPORT=y
CONFIG_LOG=y
CONFIG_USBD_LOG_LEVEL_ERR=y
CONFIG_UDC_DRIVER_LOG_LEVEL_ERR=y
CONFIG_MAIN_STACK_SIZE=2048
# USB device request buffers
CONFIG_UDC_BUF_POOL_SIZE=4096
CONFIG_UDC_BUF_COUNT=32
```

## src/main.c
```c
/*
 * Copyright (c) 2026 Roman Leonov <jam_roma@yahoo.com>
 *
 * SPDX-License-Identifier: Apache-2.0
 */

#include <zephyr/device.h>
#include <zephyr/devicetree.h>
#include <zephyr/kernel.h>
#include <zephyr/logging/log.h>
#include <zephyr/usb/usbd.h>

#include "loopback.h"

LOG_MODULE_REGISTER(usb_loopback_main, LOG_LEVEL_INF);

/* Example-only VID/PID: replace before distributing a real USB product. */
USBD_DEVICE_DEFINE(loopback_usbd, DEVICE_DT_GET(DT_NODELABEL(zephyr_udc0)), 0x2fe3, 0x0100);
USBD_DESC_LANG_DEFINE(loopback_lang);
USBD_DESC_MANUFACTURER_DEFINE(loopback_mfr, "Zephyr Test");
USBD_DESC_PRODUCT_DEFINE(loopback_product, "UHC Test Loopback");
USBD_CONFIGURATION_DEFINE(loopback_fs, 0, 50, NULL);
USBD_CONFIGURATION_DEFINE(loopback_hs, 0, 50, NULL);

static int loopback_usbd_start(void)
{
	int ret;

	ret = usbd_add_descriptor(&loopback_usbd, &loopback_lang);
	if (ret) {
		return ret;
	}
	ret = usbd_add_descriptor(&loopback_usbd, &loopback_mfr);
	if (ret) {
		return ret;
	}
	ret = usbd_add_descriptor(&loopback_usbd, &loopback_product);
	if (ret) {
		return ret;
	}

	ret = usbd_add_configuration(&loopback_usbd, USBD_SPEED_FS, &loopback_fs);
	if (ret) {
		return ret;
	}
	ret = loopback_register(&loopback_usbd, USBD_SPEED_FS);
	if (ret) {
		return ret;
	}

	if (USBD_SUPPORTS_HIGH_SPEED &&
	    usbd_caps_speed(&loopback_usbd) == USBD_SPEED_HS) {
		ret = usbd_add_configuration(&loopback_usbd, USBD_SPEED_HS,
					     &loopback_hs);
		if (ret) {
			return ret;
		}
		ret = loopback_register(&loopback_usbd, USBD_SPEED_HS);
		if (ret) {
			return ret;
		}
	}

	ret = usbd_device_set_code_triple(&loopback_usbd, USBD_SPEED_FS,
					  0, 0, 0);
	if (ret) {
		return ret;
	}

	ret = usbd_init(&loopback_usbd);
	if (ret) {
		return ret;
	}

	return usbd_enable(&loopback_usbd);
}

int main(void)
{
	int ret = loopback_usbd_start();

	if (ret) {
		LOG_ERR("USB loopback initialization failed (%d)", ret);
		return 0;
	}

	LOG_INF("USB_LOOPBACK_READY");
	return 0;
}
```

## src/loopback.c
```c
/*
 * Copyright (c) 2026 Roman Leonov <jam_roma@yahoo.com>
 *
 * SPDX-License-Identifier: Apache-2.0
 */

#include <errno.h>
#include <string.h>
#include <zephyr/kernel.h>
#include <zephyr/net_buf.h>
#include <zephyr/sys/byteorder.h>
#include <zephyr/usb/usbd.h>
#include <zephyr/usb/usb_ch9.h>
#include <zephyr/logging/log.h>
#include <zephyr/drivers/usb/udc.h>

#include "loopback.h"
#include "loopback_protocol.h"

LOG_MODULE_REGISTER(usb_loopback, LOG_LEVEL_INF);

/*
 * USB Loopback Test Device - Proposed Endpoint Layout
 *
 * Interface 0: Vendor-specific (Class 0xFF, Subclass 0x00, Protocol 0x00)
 *
 * Endpoint  Direction  Type           Description
 * -----------------------------------------------------------------------
 * EP0 OUT   0x00      CONTROL        Receive vendor-specific commands
 * EP0 IN    0x80      CONTROL        Return control responses and payloads
 *
 * EP1 OUT   0x01      BULK           Receive bulk test payloads
 * EP1 IN    0x81      BULK           Return received bulk payloads
 *
 * EP2 OUT   0x02      INTERRUPT      Receive interrupt test payloads
 * EP2 IN    0x82      INTERRUPT      Return received interrupt payloads
 *
 * EP3 OUT   0x03      ISOCHRONOUS    Receive isochronous test data
 * EP3 IN    0x83      ISOCHRONOUS    Return isochronous test data
 *
 * Full-Speed Maximum Packet Sizes:
 *   CONTROL:       64 bytes (EP0)
 *   BULK:          64 bytes
 *   INTERRUPT:     Up to 64 bytes
 *   ISOCHRONOUS:   Up to 1023 bytes
 *
 * Loopback Behavior:
 *   CONTROL:       SET_PAYLOAD stores data; GET_PAYLOAD returns it.
 *   BULK:          OUT data is buffered and returned through BULK IN.
 *   INTERRUPT:     OUT data is buffered and returned through INTERRUPT IN.
 *   ISOCHRONOUS:   OUT data is returned through ISOCHRONOUS IN;
 *                  packet loss is permitted (no retransmissions).
 */

static uint8_t payload[LOOPBACK_MAX_PAYLOAD];
static size_t payload_len;

/* BULK small helper */
static struct {
	bool enabled;
	bool armed;
	size_t req_len;
	size_t resp_len;
	size_t host_in_len;
	bool zlp_required;
} bulk_state;

/* INTR small helper */
static struct {
	bool enabled;
	bool armed;
	size_t req_len;
	size_t resp_len;
} intr_state;

/* Vendor-specific interface with BULK and INTERRUPT endpoints. */
static struct usb_if_descriptor loopback_if = {
	.bLength = sizeof(struct usb_if_descriptor),
	.bDescriptorType = USB_DESC_INTERFACE,
	.bInterfaceNumber = LOOPBACK_INTERFACE_NUMBER,
	.bAlternateSetting = 0,
	.bNumEndpoints = 4,
	.bInterfaceClass = 0xff,
	.bInterfaceSubClass = 0,
	.bInterfaceProtocol = 0,
	.iInterface = 0,
};

static struct usb_ep_descriptor ep_desc_bulk_out = {
	.bLength = sizeof(struct usb_ep_descriptor),
	.bDescriptorType = USB_DESC_ENDPOINT,
	.bEndpointAddress = LOOPBACK_BULK_OUT_EP,
	.bmAttributes = USB_EP_TYPE_BULK,
	.wMaxPacketSize = sys_cpu_to_le16(64),
	.bInterval = 0,
};

static struct usb_ep_descriptor ep_desc_bulk_in = {
	.bLength = sizeof(struct usb_ep_descriptor),
	.bDescriptorType = USB_DESC_ENDPOINT,
	.bEndpointAddress = LOOPBACK_BULK_IN_EP,
	.bmAttributes = USB_EP_TYPE_BULK,
	.wMaxPacketSize = sys_cpu_to_le16(64),
	.bInterval = 0,
};

static struct usb_ep_descriptor ep_desc_intr_out = {
	.bLength = sizeof(struct usb_ep_descriptor),
	.bDescriptorType = USB_DESC_ENDPOINT,
	.bEndpointAddress = LOOPBACK_INTR_OUT_EP,
	.bmAttributes = USB_EP_TYPE_INTERRUPT,
	.wMaxPacketSize = sys_cpu_to_le16(LOOPBACK_FS_INTR_MPS),
	.bInterval = 1,
};

static struct usb_ep_descriptor ep_desc_intr_in = {
	.bLength = sizeof(struct usb_ep_descriptor),
	.bDescriptorType = USB_DESC_ENDPOINT,
	.bEndpointAddress = LOOPBACK_INTR_IN_EP,
	.bmAttributes = USB_EP_TYPE_INTERRUPT,
	.wMaxPacketSize = sys_cpu_to_le16(LOOPBACK_FS_INTR_MPS),
	.bInterval = 1,
};

static const struct usb_desc_header *const loopback_desc[] = {
	(const struct usb_desc_header *)&loopback_if,
	(const struct usb_desc_header *)&ep_desc_bulk_out,
	(const struct usb_desc_header *)&ep_desc_bulk_in,
	(const struct usb_desc_header *)&ep_desc_intr_out,
	(const struct usb_desc_header *)&ep_desc_intr_in,
	NULL,
};

static const void *loopback_get_desc(struct usbd_class_data *const c_data,
				    const enum usbd_speed speed)
{
	ARG_UNUSED(c_data);
	ARG_UNUSED(speed);
	return loopback_desc;
}

static void loopback_bulk_reset(void)
{
	bulk_state.armed = false;
	bulk_state.zlp_required = false;
	bulk_state.req_len = 0;
	bulk_state.resp_len = 0;
	bulk_state.host_in_len = 0;
}

static void loopback_intr_reset(void)
{
	intr_state.armed = false;
	intr_state.req_len = 0;
	intr_state.resp_len = 0;
}

static bool loopback_valid_setup(const struct usb_setup_packet *setup,
				uint8_t bm_request_type, uint8_t request)
{
	return setup->bmRequestType == bm_request_type &&
	       setup->bRequest == request &&
	       sys_le16_to_cpu(setup->wIndex) == LOOPBACK_INTERFACE_NUMBER &&
	       sys_le16_to_cpu(setup->wValue) == 0;
}

static int loopback_bulk_prepare_echo(struct usbd_class_data *const c_data,
				      size_t req_len,
				      size_t resp_len,
				      size_t host_in_len)
{
	struct net_buf *buf;
	int ret;

	if (!bulk_state.enabled) {
		return -EACCES;
	}

	if (req_len == 0 ||
		req_len > LOOPBACK_MAX_PAYLOAD ||
		resp_len > req_len ||
		resp_len > host_in_len ||
		host_in_len > LOOPBACK_MAX_PAYLOAD) {
		return -EINVAL;
	}

	if (bulk_state.armed) {
		return -EBUSY;
	}

	buf = usbd_ep_buf_alloc(c_data, LOOPBACK_BULK_OUT_EP, req_len);
	if (buf == NULL) {
		return -ENOMEM;
	}

	bulk_state.req_len = req_len;
	bulk_state.resp_len = resp_len;
	bulk_state.host_in_len = host_in_len;
	bulk_state.armed = true;

	bulk_state.zlp_required =
		(resp_len < host_in_len) &&
		(resp_len % LOOPBACK_FS_BULK_MPS == 0);

	LOG_INF("BULK req_len=%u, resp_len=%u, host_in_len=%u",
		(unsigned int)req_len,
		(unsigned int)resp_len,
		(unsigned int)host_in_len);

	ret = usbd_ep_enqueue(c_data, buf);
	if (ret != 0) {
		loopback_bulk_reset();
		net_buf_unref(buf);
	}

	return ret;
}

static int loopback_intr_prepare_echo(struct usbd_class_data *const c_data,
				      size_t req_len,
				      size_t resp_len,
				      size_t host_in_len)
{
	struct net_buf *buf;
	int ret;

	if (!intr_state.enabled) {
		return -EACCES;
	}

	if (req_len == 0 ||
	    req_len > LOOPBACK_FS_INTR_MPS ||
	    resp_len == 0 ||
	    resp_len > req_len ||
	    resp_len > host_in_len ||
	    host_in_len > LOOPBACK_FS_INTR_MPS) {
		return -EINVAL;
	}

	if (intr_state.armed) {
		return -EBUSY;
	}

	buf = usbd_ep_buf_alloc(c_data, LOOPBACK_INTR_OUT_EP, req_len);
	if (buf == NULL) {
		return -ENOMEM;
	}

	intr_state.req_len = req_len;
	intr_state.resp_len = resp_len;
	intr_state.armed = true;

	LOG_INF("INTR req_len=%u, resp_len=%u, host_in_len=%u",
		(unsigned int)req_len,
		(unsigned int)resp_len,
		(unsigned int)host_in_len);

	ret = usbd_ep_enqueue(c_data, buf);
	if (ret != 0) {
		loopback_intr_reset();
		net_buf_unref(buf);
	}

	return ret;
}

static int loopback_control_to_dev(struct usbd_class_data *const c_data,
				   const struct usb_setup_packet *const setup,
				   const struct net_buf *const buf)
{
	uint16_t length = sys_le16_to_cpu(setup->wLength);

	/* Vendor-specific, host-to-device, interface recipient */
	if (setup->bmRequestType != LOOPBACK_BMREQUEST_OUT ||
		setup->wIndex != LOOPBACK_INTERFACE_NUMBER) {
		return -ENOTSUP;
	}

	switch (setup->bRequest) {
	case LOOPBACK_REQ_SET_PAYLOAD:
		if (length > LOOPBACK_MAX_PAYLOAD) {
			return -EINVAL;
		}

		/*
		 * For requests with a DATA OUT stage, Zephyr calls
		 * this handler twice:
		 *
		 * 1. buf == NULL: validate the request.
		 * 2. buf != NULL: process the received data.
		 */
		if (buf == NULL) {
			return 0;
		}

		if (buf->len != length) {
			return -EINVAL;
		}

		memcpy(payload, buf->data, length);
		payload_len = length;
		LOG_INF("SET_PAYLOAD len=%u", (unsigned int)payload_len);

		return 0;

	case LOOPBACK_BULK_REQ_ECHO:
	case LOOPBACK_INTR_REQ_ECHO: {
		uint16_t echo_req_len;
		uint16_t echo_resp_len;
		uint16_t echo_host_in_len;

		if (length != 6 ||
			sys_le16_to_cpu(setup->wIndex) != LOOPBACK_INTERFACE_NUMBER ||
			sys_le16_to_cpu(setup->wValue) != 0) {
			return -EINVAL;
		}

		/* First callback validates SETUP; second receives DATA OUT. */
		if (buf == NULL) {
			return 0;
		}

		if (buf->len != 6) {
			return -EINVAL;
		}

		echo_req_len = sys_get_le16(&buf->data[0]);
		echo_resp_len = sys_get_le16(&buf->data[2]);
		echo_host_in_len = sys_get_le16(&buf->data[4]);

		LOG_INF("ECHO %s prepare, req_len=%u, resp_len=%u, host_in_len=%u",
			setup->bRequest == LOOPBACK_BULK_REQ_ECHO ? "BULK" : "INTR",
			echo_req_len, echo_resp_len, echo_host_in_len);

		if (setup->bRequest == LOOPBACK_INTR_REQ_ECHO) {
			return loopback_intr_prepare_echo(c_data,
							  echo_req_len,
							  echo_resp_len,
							  echo_host_in_len);
		}

		return loopback_bulk_prepare_echo(c_data,
						  echo_req_len,
						  echo_resp_len,
						  echo_host_in_len);
	}

	default:
		return -ENOTSUP;
	}
}

static struct net_buf *loopback_control_to_host(struct usbd_class_data *const c_data,
						const struct usb_setup_packet *const setup)
{
	struct usbd_context *ctx = usbd_class_get_ctx(c_data);
	size_t requested = sys_le16_to_cpu(setup->wLength);
	struct net_buf *buf;
	size_t len;

	if (!loopback_valid_setup(setup, LOOPBACK_BMREQUEST_IN,
				  LOOPBACK_REQ_GET_PAYLOAD)) {
		return NULL;
	}

	len = MIN(requested, payload_len);

	LOG_INF("GET_PAYLOAD len=%u", (unsigned int)len);

	buf = usbd_ep_ctrl_data_in_alloc(ctx, len);
	if (buf == NULL) {
		return NULL;
	}

	net_buf_add_mem(buf, payload, len);
	return buf;
}

static int loopback_init(struct usbd_class_data *const c_data)
{
	ARG_UNUSED(c_data);

	return 0;
}

static void loopback_enable(struct usbd_class_data *const c_data)
{
	ARG_UNUSED(c_data);

	bulk_state.enabled = true;
	intr_state.enabled = true;
	LOG_INF("USB loopback configured");
}

static void loopback_disable(struct usbd_class_data *const c_data)
{
	ARG_UNUSED(c_data);

	bulk_state.enabled = false;
	loopback_bulk_reset();

	intr_state.enabled = false;
	loopback_intr_reset();

	LOG_INF("USB loopback disabled");
}

static int loopback_request(struct usbd_class_data *const c_data,
			    struct net_buf *buf, int err)
{
	struct usbd_context *ctx = usbd_class_get_ctx(c_data);
	uint8_t ep = udc_get_buf_info(buf)->ep;
	struct net_buf *reply;
	int ret;

	if (ep == LOOPBACK_BULK_OUT_EP) {
		if (err != 0 ||
		    !bulk_state.armed ||
		    buf->len != bulk_state.req_len) {
			LOG_ERR("BULK OUT failed: err=%d len=%u req_len=%zu",
				err, buf->len, bulk_state.req_len);

			loopback_bulk_reset();
			return usbd_ep_buf_free(ctx, buf);
		}

		reply = usbd_ep_buf_alloc(c_data, LOOPBACK_BULK_IN_EP,
					 bulk_state.resp_len);
		if (reply == NULL) {
			LOG_ERR("BULK IN buffer allocation failed");


			loopback_bulk_reset();
			return usbd_ep_buf_free(ctx, buf);
		}

		net_buf_add_mem(reply, buf->data, bulk_state.resp_len);

		ret = usbd_ep_buf_free(ctx, buf);
		if (ret != 0) {
			LOG_ERR("BULK OUT buffer free failed: %d", ret);
		}

		ret = usbd_ep_enqueue(c_data, reply);
		if (ret != 0) {
			LOG_ERR("BULK IN enqueue failed: %d", ret);
			net_buf_unref(reply);

			loopback_bulk_reset();
		}

		/* Keep armed until BULK IN (and optional ZLP) completes. */
		return ret;
	}

	if (ep == LOOPBACK_BULK_IN_EP) {
		bool send_zlp = bulk_state.zlp_required;

		ret = usbd_ep_buf_free(ctx, buf);
		if (ret != 0) {
			LOG_ERR("BULK IN buffer free failed: %d", ret);
			loopback_bulk_reset();
			return ret;
		}

		if (err != 0) {
			LOG_ERR("BULK IN failed: %d", err);
			ret = err;
			loopback_bulk_reset();
			return ret;
		}

		if (send_zlp) {
			bulk_state.zlp_required = false;

			reply = usbd_ep_buf_alloc(c_data,
						 LOOPBACK_BULK_IN_EP, 0);
			if (reply == NULL) {
				LOG_ERR("BULK IN ZLP allocation failed");
				ret = -ENOMEM;
				loopback_bulk_reset();
				return ret;
			}

			LOG_INF("BULK IN sending ZLP");

			ret = usbd_ep_enqueue(c_data, reply);
			if (ret != 0) {
				LOG_ERR("BULK IN ZLP enqueue failed: %d", ret);
				net_buf_unref(reply);
				loopback_bulk_reset();
				return ret;
			}

			/*
			 * ZLP is queued. Keep the transfer armed until
			 * its completion callback.
			 */
			return 0;
		}

		/* BULK IN completed successfully */
		loopback_bulk_reset();
		return ret;
	}

	if (ep == LOOPBACK_INTR_OUT_EP) {
		if (err != 0 ||
		    !intr_state.armed ||
		    buf->len != intr_state.req_len) {
			LOG_ERR("INTR OUT failed: err=%d len=%u req_len=%zu",
				err, buf->len, intr_state.req_len);

			loopback_intr_reset();
			return usbd_ep_buf_free(ctx, buf);
		}

		reply = usbd_ep_buf_alloc(c_data, LOOPBACK_INTR_IN_EP,
					 intr_state.resp_len);
		if (reply == NULL) {
			LOG_ERR("INTR IN buffer allocation failed");

			loopback_intr_reset();
			return usbd_ep_buf_free(ctx, buf);
		}

		net_buf_add_mem(reply, buf->data, intr_state.resp_len);

		ret = usbd_ep_buf_free(ctx, buf);
		if (ret != 0) {
			LOG_ERR("INTR OUT buffer free failed: %d", ret);
			net_buf_unref(reply);
			loopback_intr_reset();
			return ret;
		}

		ret = usbd_ep_enqueue(c_data, reply);
		if (ret != 0) {
			LOG_ERR("INTR IN enqueue failed: %d", ret);
			net_buf_unref(reply);
			loopback_intr_reset();
		}

		/* Keep armed until IN completes. */
		return ret;
	}

	if (ep == LOOPBACK_INTR_IN_EP) {
		ret = usbd_ep_buf_free(ctx, buf);

		if (err != 0) {
			LOG_ERR("INTR IN failed: %d", err);
		}

		loopback_intr_reset();

		return ret != 0 ? ret : err;
	}

	return usbd_ep_buf_free(ctx, buf);
}

static const struct usbd_class_api loopback_api = {
	.init = loopback_init,
	.enable = loopback_enable,
	.disable = loopback_disable,
	.request = loopback_request,
	.control_to_dev = loopback_control_to_dev,
	.control_to_host = loopback_control_to_host,
	.get_desc = loopback_get_desc,
};

static const struct usbd_cctx_vendor_req loopback_vreqs =
	USBD_VENDOR_REQ(LOOPBACK_REQ_SET_PAYLOAD,
			LOOPBACK_REQ_GET_PAYLOAD,
			LOOPBACK_BULK_REQ_ECHO,
			LOOPBACK_INTR_REQ_ECHO);

USBD_DEFINE_CLASS(usb_loopback, &loopback_api, NULL, &loopback_vreqs);

int loopback_register(struct usbd_context *ctx, enum usbd_speed speed)
{
	return usbd_register_class(ctx, "usb_loopback", speed, 1);
}
```

## src/loopback.h
```c
/*
 * Copyright (c) 2026 Roman Leonov <jam_roma@yahoo.com>
 *
 * SPDX-License-Identifier: Apache-2.0
 */

#ifndef USB_LOOPBACK_H_
#define USB_LOOPBACK_H_

#include <zephyr/usb/usbd.h>

/* Register the loopback class on a USBD configuration at the given speed. */
int loopback_register(struct usbd_context *ctx, enum usbd_speed speed);

#endif /* USB_LOOPBACK_H_ */
```

## src/loopback_protocol.h
```c
/*
 * Copyright (c) 2026 Roman Leonov <jam_roma@yahoo.com>
 *
 * SPDX-License-Identifier: Apache-2.0
 */

#ifndef USB_LOOPBACK_PROTOCOL_H_
#define USB_LOOPBACK_PROTOCOL_H_

#define LOOPBACK_MAX_PAYLOAD            2048U

#define LOOPBACK_BMREQUEST_OUT          0x41
#define LOOPBACK_BMREQUEST_IN           0xC1

#define LOOPBACK_REQ_SET_PAYLOAD        0x01
#define LOOPBACK_REQ_GET_PAYLOAD        0x02

#define LOOPBACK_INTERFACE_NUMBER       0

/* BULK endpoint addresses */
#define LOOPBACK_BULK_OUT_EP            0x01U
#define LOOPBACK_BULK_IN_EP             0x81U

/* INTERRUPT endpoint addresses */
#define LOOPBACK_INTR_OUT_EP            0x02U
#define LOOPBACK_INTR_IN_EP             0x82U

/* Full-speed and high-speed packet sizes */
#define LOOPBACK_FS_BULK_MPS            64U
#define LOOPBACK_HS_BULK_MPS            512U
#define LOOPBACK_FS_INTR_MPS            64U

/*
 * ECHO:
 *   bmRequestType = 0x41 (vendor, host-to-device, interface)
 *   bRequest      = 0x03 (BULK) or 0x04 (INTERRUPT)
 *   wValue        = 0
 *   wIndex        = LOOPBACK_INTERFACE_NUMBER
 *   wLength       = 6
 *
 *   DATA OUT:
 *     bytes 0..1: OUT request length (LE16)
 *     bytes 2..3: IN response length (LE16)
 *     bytes 4..5: Host IN request length (LE16)
 */
#define LOOPBACK_BULK_REQ_ECHO          0x03
#define LOOPBACK_INTR_REQ_ECHO          0x04

#endif /* USB_LOOPBACK_PROTOCOL_H_ */
```
