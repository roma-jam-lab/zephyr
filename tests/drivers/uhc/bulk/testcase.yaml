## tests/drivers/uhc/bulk/testcase.yaml
```yaml
tests:
  drivers.usb.uhc.bulk:
    tags:
      - drivers
      - usb
      - uhc
    platform_allow:
      - esp32s3_devkitc/esp32s3/procpu
      - nrf54lm20dk/nrf54lm20b/cpuapp
    harness: ztest
```

## tests/drivers/uhc/testcase.yaml
```yaml
tests:
  drivers.usb.uhc:
    tags:
      - drivers
    platform_allow:
      - esp32s3_devkitc/esp32s3/procpu
```
